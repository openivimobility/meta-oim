## conf/bblayers.conf.sample
```bitbake
# LAYER_CONF_VERSION is increased each time build/conf/bblayers.conf
# changes incompatibly
LCONF_VERSION = "6"

BBPATH = "${TOPDIR}"
BBFILES ?= ""

BBLAYERS ?= " \
  ##OEROOT##/meta \
  ##OEROOT##/meta-intel \
  ##OEROOT##/meta-yocto \
  ##OEROOT##/meta-yocto-bsp \
  ##OEROOT##/meta-qt5 \
  ##OEROOT##/meta-rust \
  ##OEROOT##/meta-openembedded/meta-oe \
  ##OEROOT##/meta-oim \
  "
BBLAYERS_NON_REMOVABLE ?= " \
  ##OEROOT##/meta \
  ##OEROOT##/meta-yocto \
  "
```

## conf/distro/poky-ats.conf
```bitbake
require conf/distro/poky.conf

DISTRO ="poky-ats"
DISTRO_NAME = "ATS Linux"
DISTRO_VERSION = "0.314"
DISTRO_CODENAME = "ats"

DISTRO_FEATURES_append = " x11 systemd "
DISTRO_FEATURES_BACKFILL_CONSIDERED = "sysvinit"
VIRTUAL-RUNTIME_init_manager = "systemd"
PACKAGECONFIG_append_pn-qtbase = " icu xcb accessibility"
```

## conf/layer.conf
```bitbake
BBPATH .= ":${LAYERDIR}"

BBFILES += "${LAYERDIR}/recipes-*/*/*.bb \
            ${LAYERDIR}/recipes-*/*/*.bbappend"

BBFILE_COLLECTIONS += "oim"
BBFILE_PATTERN_oim = "^${LAYERDIR}/"
BBFILE_PRIORITY_oim = "10"
LAYERVERSION_oim = "2"
```

## meta-jaspar/conf/bblayers.conf.sample
```bitbake
# LAYER_CONF_VERSION is increased each time build/conf/bblayers.conf
# changes incompatibly
LCONF_VERSION = "6"

BBPATH = "${TOPDIR}"
BBFILES ?= ""

BBLAYERS ?= " \
  ##OEROOT##/meta \
  ##OEROOT##/meta-intel \
  ##OEROOT##/meta-yocto \
  ##OEROOT##/meta-yocto-bsp \
  ##OEROOT##/meta-openembedded/meta-oe \
  ##OEROOT##/meta-openembedded/meta-gnome \
  ##OEROOT##/meta-openembedded/meta-multimedia \
  ##OEROOT##/meta-openembedded/meta-python \
  ##OEROOT##/meta-qt5 \
  ##OEROOT##/meta-oim/meta-jaspar \
  "
BBLAYERS_NON_REMOVABLE ?= " \
  ##OEROOT##/meta \
  ##OEROOT##/meta-yocto \
  "
```

## meta-jaspar/conf/layer.conf
```bitbake
BBPATH .= ":${LAYERDIR}"

BBFILES += "${LAYERDIR}/recipes-*/*/*.bb \
            ${LAYERDIR}/recipes-*/*/*.bbappend"

BBFILE_COLLECTIONS += "oim"
BBFILE_PATTERN_oim = "^${LAYERDIR}/"
BBFILE_PRIORITY_oim = "10"
LAYERVERSION_oim = "2"

PACKAGECONFIG_append_pn-qtbase = " icu -xcb"

DISTRO_FEATURES_append = " xinit x11 systemd "
IMAGE_INSTALL_append += " ruby"
LICENSE_PATH += " ${LAYERDIR}/licenses"
```
